/ {
    behaviors {
        hm: homerow_mods {
            compatible = "zmk,behavior-hold-tap";
            label = "HOMEROW_MODS";
            #binding-cells = <2>;
            tapping-term-ms = <200>;
            quick_tap_ms = <200>;
            require-prior-idle-ms = <125>;
            flavor = "balanced";
            global-quick-tap;
            bindings = <&kp>, <&kp>;
        };
    };
};
