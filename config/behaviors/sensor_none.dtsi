/*
 * Empty sensor-binding slot.
 *
 * The sensor-bindings phandle-array requires #sensor-binding-cells,
 * which &none does not expose (its binding rejects it). This wrapper
 * uses the sensor-rotate-var driver — the same as &inc_dec_kp — with
 * both directions bound to &none: rotation is accepted and then
 * swallowed by the none behavior, so the slot does nothing at all.
 */

/ {
    behaviors {
        sensor_none: sensor_none {
            compatible = "zmk,behavior-sensor-rotate-var";
            #sensor-binding-cells = <2>;
            bindings = <&none>, <&none>;
        };
    };
};
