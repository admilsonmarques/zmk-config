## config/boards/shields/corne_dongle/Kconfig.defconfig
```kconfig
# Copyright (c) 2024 The ZMK Contributors
# SPDX-License-Identifier: MIT

if SHIELD_CORNE_DONGLE_LEFT

config ZMK_KEYBOARD_NAME
    default "Ade Corne Left"

config ZMK_SPLIT_ROLE_CENTRAL
    default n

endif

if SHIELD_CORNE_DONGLE_RIGHT

config ZMK_KEYBOARD_NAME
    default "Ade Corne Right"

config ZMK_SPLIT_ROLE_CENTRAL
    default n

endif

if SHIELD_UNIVERSAL_DONGLE

config ZMK_KEYBOARD_NAME
    default "Ade Universal Dongle"

config ZMK_SPLIT_ROLE_CENTRAL
    default y

endif

if SHIELD_CORNE_DONGLE_LEFT || SHIELD_CORNE_DONGLE_RIGHT || SHIELD_UNIVERSAL_DONGLE

config ZMK_SPLIT
    default y

endif 
```

## config/boards/shields/corne_dongle/Kconfig.shield
```kconfig
# Copyright (c) 2024 The ZMK Contributors
# SPDX-License-Identifier: MIT

config SHIELD_CORNE_DONGLE_LEFT
    def_bool $(shields_list_contains,corne_dongle_left)

config SHIELD_CORNE_DONGLE_RIGHT
    def_bool $(shields_list_contains,corne_dongle_right)

config SHIELD_CORNE_DONGLE_DONGLE
    def_bool $(shields_list_contains,corne_dongle_dongle) 
```

## config/boards/shields/sweep/Kconfig.defconfig
```kconfig
if SHIELD_SWEEP_LEFT
# Name must be less than 16 characters long!
config ZMK_KEYBOARD_NAME
    default "Sweep Pro"

config ZMK_SPLIT_ROLE_CENTRAL
    default y

endif 


if SHIELD_SWEEP_DONGLE_LEFT
config ZMK_KEYBOARD_NAME
    default "Sweep Pro"

config ZMK_SPLIT_ROLE_CENTRAL
    default n

endif

if SHIELD_SWEEP_LEFT || SHIELD_SWEEP_RIGHT || SHIELD_SWEEP_DONGLE_LEFT
config ZMK_SPLIT
    default y
endif
```

## config/boards/shields/totem/Kconfig.defconfig
```kconfig
# Copyright (c) 2022 The ZMK Contributors
# SPDX-License-Identifier: MIT

if SHIELD_TOTEM_LEFT || SHIELD_TOTEM_RIGHT

config ZMK_SPLIT
    default y

config ZMK_BLE
    default y

endif
```
